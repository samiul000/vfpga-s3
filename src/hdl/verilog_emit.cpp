#include "verilog_emit.h"

void VerilogEmitter::pad(std::string &out, int indent) {
    out.append((size_t)indent * 4, ' ');
}

std::string VerilogEmitter::range(const AstNode &n) const {
    // msb/lsb default to -1 for scalars (see parser decl fns).
    if (n.msb >= 0 && n.lsb >= 0) {
        return "[" + std::to_string(n.msb) + ":" + std::to_string(n.lsb) + "] ";
    }
    return "";
}

std::string VerilogEmitter::rhs(const AstNode &n) const {
    // Expressions arrive flattened: children are operand name strings,
    // op is the operator text (parser.cpp parse_expr/parse_assign).
    // NOTE: chained ops (a & b & c) already collapse in the AST itself
    // (intermediate names are empty) - the fabric mapper shares this limit.
    if (n.op == "!" && !n.children.empty()) {
        return "(~" + n.children[0] + ")";
    }
    if (!n.op.empty() && n.children.size() >= 2) {
        return "(" + n.children[0] + " " + n.op + " " + n.children[1] + ")";
    }
    if (!n.children.empty()) {
        return n.children[0];
    }
    return "1'b0";
}

std::string VerilogEmitter::cond(const AstNode &n) const {
    if (n.op == "!" && !n.children.empty()) {
        return "(~" + n.children[0] + ")";
    }
    if (!n.op.empty()) {
        // Binary conditions (a == b) lose their operands in the AST
        // (parse_if keeps cond.name only) - flag loudly, take then-branch.
        return "1'b1 /* WARNING: complex condition simplified */";
    }
    if (!n.children.empty()) {
        return n.children[0];
    }
    return "1'b0";
}

void VerilogEmitter::stmt(const AstNode &n, std::string &out, int indent) const {
    using T = AstNode::Type;
    switch (n.type) {
        case T::ASSIGN:
            pad(out, indent);
            out += "assign " + n.name + " = " + rhs(n) + ";\n";
            break;
        case T::ASSIGN_LE:
            pad(out, indent);
            out += n.name + " <= " + rhs(n) + ";\n";
            break;
        case T::IF: {
            pad(out, indent);
            out += "if (" + cond(n) + ")\n";
            if (!n.sub_nodes.empty()) stmt(n.sub_nodes[0], out, indent + 1);
            if (n.sub_nodes.size() > 1) {
                pad(out, indent);
                out += "else\n";
                stmt(n.sub_nodes[1], out, indent + 1);
            }
            break;
        }
        case T::BEGIN_END:
            pad(out, indent);
            out += "begin\n";
            for (const auto &s : n.sub_nodes) stmt(s, out, indent + 1);
            pad(out, indent);
            out += "end\n";
            break;
        case T::ALWAYS_POSEDGE:
            pad(out, indent);
            out += "always @(posedge " + n.name + ") begin\n";
            for (const auto &s : n.sub_nodes) stmt(s, out, indent + 1);
            pad(out, indent);
            out += "end\n";
            break;
        default:
            break;
    }
}

std::string VerilogEmitter::emit(const std::string &module_name,
                                 const std::vector<AstNode> &ast) {
    using T = AstNode::Type;
    std::string ports;
    bool first = true;
    for (const auto &n : ast) {
        if (n.type == T::INPUT || n.type == T::OUTPUT) {
            if (!first) ports += ", ";
            ports += n.name;
            first = false;
        }
    }

    std::string out = "// Generated by VFPGA-S3 VerilogEmitter (AST -> behavioral Verilog).\n";
    out += "// NOTE: '+' synthesizes WITH carry; the toolchain builds matching ripple-carry logic (XOR3/MAJ3).\n";
    out += "module " + module_name + "(" + ports + ");\n";

    for (const auto &n : ast) {
        switch (n.type) {
            case T::INPUT:
                out += "input " + range(n) + n.name + ";\n";
                break;
            case T::OUTPUT:
                out += "output " + range(n) + n.name + ";\n";
                break;
            case T::WIRE:
                out += "wire " + range(n) + n.name + ";\n";
                break;
            case T::REGISTER:
                out += "reg " + range(n) + n.name + ";\n";
                break;
            case T::ASSIGN:
            case T::ASSIGN_LE:
            case T::IF:
            case T::BEGIN_END:
            case T::ALWAYS_POSEDGE:
                stmt(n, out, 1);
                break;
            default:
                break;
        }
    }
    out += "endmodule\n";
    return out;
}
