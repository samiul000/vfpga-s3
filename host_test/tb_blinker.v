/*
   Self-contained Icarus Verilog testbench.
   DUT below is the verbatim VerilogEmitter golden output for
   the 1-bit blinker (see test_hdl.cpp "Blinker Verilog emission").
   Hierarchical init stands in for the fabric's zeroed power-on state.
   Run: iverilog -o /tmp/tb_blinker host_test/tb_blinker.v && vvp /tmp/tb_blinker
   Generated by VFPGA-S3 VerilogEmitter (AST -> behavioral Verilog).
   NOTE: '+' synthesizes WITH carry; the toolchain builds matching ripple-carry logic (XOR3/MAJ3).
*/
module blinker(clock, led);
input clock;
output led;
reg q;
    always @(posedge clock) begin
        q <= (q ^ 1);
    end
    assign led = q;
endmodule

module tb_blinker;
reg clock;
wire led;
blinker dut(clock, led);
integer i, fails, exp;
initial begin
    fails = 0; clock = 0; dut.q = 1'b0;
    #5;
    for (i = 0; i < 8; i = i + 1) begin
        exp = (i % 2 == 0) ? 1 : 0;
        #10; clock = 1; #1;
        if (led !== exp) fails = fails + 1;
        #9; clock = 0;
    end
    if (fails == 0) $display("TB-BLINKER PASS");
    else $display("TB-BLINKER FAIL %0d", fails);
    $finish;
end
endmodule
